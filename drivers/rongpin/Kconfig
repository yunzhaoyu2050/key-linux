## drivers/rongpin/Kconfig
```kconfig
menu "rongpin support"

config POWER_EN
	default y
	tristate "rongpin 5v_en support"

		
config RP_GPIO
        tristate "rp gpio driver"
        default y
        help
          Say yes here to build support for "rp_gpio.c".

endmenu
```
